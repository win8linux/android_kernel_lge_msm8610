## drivers/nfc/Kconfig
```kconfig
config NFC_NXP_PN5XX
	tristate "NXP PN5XX based driver"
	depends on I2C
	select CRC_CCITT
	default n
	---help---
	  NXP PN5XX driver based on I2C.
	  This is a driver to provides I2C access to PN5xx NFC Controller devices 

	  To compile this driver as a module, choose m here. The module will
	  be called pn5xx_i2c.
	  Say N if unsure.
config LGE_NFC_PN547_C2		
    bool "PN547 C2 NFC driver"		
    depends on I2C		
	select CRC_CCITT		
	default n		
	---help---		
 		Say yes if you want PN547 Near Field Communication driver.		
		This is for i2c connected version. If unsure, say N here.
config LGE_NFC_SET_IRQ_WAKEUP		
	bool "NFC Set IRQ wakeup when NFC ON"		
	default n		
	---help---		
		Say yes if Set IRQ Wakeup NFC ON.		
		If unsure, say N here.
```
